## CMakeLists.txt
```
cmake_minimum_required(VERSION 3.20.0)
find_package(Zephyr REQUIRED HINTS $ENV{ZEPHYR_BASE})

project(Reader)
include_directories(SDK/v2.5.99-dev1/nrfxlib/zboss/production/include)
# include_directories(SDK/v2.5.99-dev1)
target_sources(app PRIVATE src/main.c)
```

## prj.conf
```kconfig
CONFIG_ZIGBEE=y
CONFIG_NRF_SECURITY=y


# info about the Zigbee stack settings https://developer.nordicsemi.com/nRF_Connect_SDK/doc/latest/nrf/libraries/zigbee/osif.html
```

## src/main.c
```c
#include <zephyr/kernel.h>
#include "zboss_api.h"
#include "zigbee_network/zigbee_init.h"

int main(void)
{
    zigbee_init();
    return 0;
}
```
